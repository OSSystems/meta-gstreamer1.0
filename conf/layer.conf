## conf/layer.conf
```bitbake
# We have a conf and classes directory, add to BBPATH
BBPATH .= ":${LAYERDIR}"

# We have a packages directory, add to BBFILES
BBFILES += "${LAYERDIR}/recipes-*/*/*.bb ${LAYERDIR}/recipes-*/*/*.bbappend"

BBFILE_COLLECTIONS += "gstreamer1.0"
BBFILE_PATTERN_gstreamer1.0 := "^${LAYERDIR}/"
BBFILE_PRIORITY_gstreamer1.0 = "6"

LAYERSERIES_COMPAT_gstreamer1.0 = "rocko"
```
